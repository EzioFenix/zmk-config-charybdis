## config/west.yml
```yaml
manifest:
  remotes:
    - name: zmkfirmware
      url-base: https://github.com/zmkfirmware
    - name: inorichi
      url-base: https://github.com/inorichi

  projects:
    - name: zmk
      remote: zmkfirmware
      revision: v0.2.1
      import: app/west.yml

    - name: zmk-pmw3610-driver
      remote: inorichi
      revision: 9f9a1c6   # commit estable conocido
  self:
    path: config
```
